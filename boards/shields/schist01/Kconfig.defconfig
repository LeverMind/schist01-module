## boards/shields/schist01/Kconfig.defconfig
```kconfig
# Copyright (c) 2020 The ZMK Contributors
# SPDX-License-Identifier: MIT

if SHIELD_SCHIST01

config ZMK_KEYBOARD_NAME
    default "Schist01"

#config ZMK_SPLIT_ROLE_CENTRAL
#    default y

endif
```

## boards/shields/schist01/Kconfig.shield
```kconfig
# Copyright (c) 2020 The ZMK Contributors
# SPDX-License-Identifier: MIT

config SHIELD_SCHIST01
    def_bool $(shields_list_contains,schist01)
```

## config/west.yml
```yaml
manifest:
  remotes:
    - name: zmkfirmware
      url-base: https://github.com/zmkfirmware
    - name: petecirque
      url-base: https://github.com/petejohanson
    - name: badjeff
      url-base: https://github.com/badjeff
    # Additional modules containing boards/shields/custom code can be listed here as well
    # See https://docs.zephyrproject.org/3.2.0/develop/west/manifest.html#projects
  projects:
    - name: zmk
      remote: zmkfirmware
      revision: main
      import: app/west.yml
    - name: cirque-input-module
      remote: petecirque
      revision: main
    - name: zmk-behavior-insomnia
      remote: badjeff
      revision: main
    - name: zmk-behavior-key-press-lip
      remote: badjeff
      revision: main
    - name: zmk-behavior-key-tempo
      remote: badjeff
      revision: main
    - name: zmk-behavior-mouse-key-toggle
      remote: badjeff
      revision: main
  self:
    path: config
```
